// 送信データの例1
unsigned int airConOn[595] = {
3373,1611,460,1183,467,413,465,410,468,410,468,410,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468
};

// 送信データの例1
unsigned int PowerOff[595] = {
3363,1613,442,1198,468,413,466,408,468,412,468,408,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472
};

/*
  ESPrIR_sender.ino
  ESPr IR から赤外線データを送信する
  Shop: https://www.switch-science.com/
  Blog: http://mag.switch-science.com/
*/

#include <ESP8266WiFi.h>
#include <WiFiClient.h>
#include <ESP8266WebServer.h>
#include <ESP8266mDNS.h>

#define IRLEDPIN 14

const char *ssid = "****";
const char *password = "****";

ESP8266WebServer server ( 80 );


void setup() {
  Serial.begin(115200);
  WiFi.begin(ssid, password);
  Serial.println("");

  while( WiFi.status() != WL_CONNECTED){
    delay(500);
    Serial.print(".");
  }
  Serial.println("");
  Serial.print("Connected to ");
  Serial.println(ssid);
  Serial.print("IP address: ");
  Serial.println(WiFi.localIP());

  server.on("/",handleRoot);
  server.onNotFound(handleNotFound);
  server.begin();
  Serial.println("HTTP server started");

  pinMode(IRLEDPIN,OUTPUT);
  pinMode(13,OUTPUT);
  pinMode(5,INPUT);
}

void loop() {
  server.handleClient();
}

void handleRoot() {
  char temp[1500];
  int sec = millis() / 1000;
  int min = sec / 60;
  int hr = min / 60;

  char message[20];
  String(server.arg(0)).toCharArray(message,20);

  if(server.arg(0).indexOf("Power Off") != -1){
    Serial.println("PowerOff");
    sendIRData(PowerOff,595);
  }
  else if(server.arg(0).indexOf("air-con On") != -1){
    Serial.println("air-con On");
    sendIRData(airConOn,595);
  }
  
  snprintf ( temp, 1500,

"<html>\
  <head>\
    <title>ESPr IR Demo</title>\
    <style>\
      body { background-color: #cccccc; font-family: Arial, Helvetica, Sans-Serif; Color: #000088; }\
    </style>\
  </head>\
  <body>\
    <h1>ESPr IR DEMO</h1>\
    <p>Uptime: %02d:%02d:%02d</p>\
    <p>BUTTON :%s</p>\
    <form action=\"/\" method=\"post\">\
      <input type=\"submit\" name=\"button1\" value=\"Power Off\" style=\"width:30%; height:100px\">\
      <input type=\"submit\" name=\"button2\" value=\"air-con On\" style=\"width:30%; height:100px\">\
    </form>\
  </body>\
</html>",

    hr, min % 60, sec % 60 ,message
    
  );
  server.send ( 200, "text/html", temp );
}

void handleNotFound() {

  String message = "File Not Found\n\n";
  message += "URI: ";
  message += server.uri();
  message += "\nMethod: ";
  message += ( server.method() == HTTP_GET ) ? "GET" : "POST";
  message += "\nArguments: ";
  message += server.args();
  message += "\n";

  for ( uint8_t i = 0; i < server.args(); i++ ) {
    message += " " + server.argName ( i ) + ": " + server.arg ( i ) + "\n";
  }
  server.send ( 404, "text/plain", message );

}

void sendIRData(unsigned int  *data, int dataSize)
{
  unsigned int i=0,power=HIGH;

  digitalWrite(IRLEDPIN, LOW);
  
  while(i < dataSize)
  {
    if(power == HIGH)
    {
      long startedTime = micros();
      while(micros() - startedTime < data[i])
      {
        digitalWrite(IRLEDPIN, HIGH);
        delayMicroseconds(8);
        digitalWrite(IRLEDPIN, LOW);
        delayMicroseconds(13);
      }

      power = LOW;
    }else{
      digitalWrite(IRLEDPIN, LOW);
      delayMicroseconds(data[i]);
      power = HIGH;
    }
    i++;
  }

  digitalWrite(IRLEDPIN, LOW);

}
